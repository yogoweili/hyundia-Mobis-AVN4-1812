## kernel/arch/arm/configs/daudio_kr_defconfig
```kconfig
CONFIG_TCC_MEM_2048MB=y
CONFIG_DDR3_MT41K512M8=y
CONFIG_USB_LGIT_GOBIUSBNET=y
CONFIG_USB_ACM=y
CONFIG_USB_SERIAL=y
CONFIG_USB_SERIAL_GENERIC=y
CONFIG_USB_SERIAL_KT_LGIT_MODEM=y
# Virtual Driver
CONFIG_DUP_UART=y
# DMB
CONFIG_DVB_CORE=y
```

## kernel/arch/arm/configs/daudio_xx_defconfig
```kconfig
CONFIG_TCC_MEM_1024MB=y
CONFIG_DDR3_H5TQ4G83AFR_PBC=y
CONFIG_TOUCHSCREEN_SOLOMON_SSD2532=y
```

## kernel/arch/arm/mach-tcc893x/Kconfig
```kconfig
if ARCH_TCC893X

choice
	prompt "TCC893x Chipset Type"
	default CHIP_TCC8930
	depends on ARCH_TCC893X
	help
	  Select TCC893x Chipset type.

config CHIP_TCC8930
	bool "TCC8930 Chipset"
	help
	  Support for the TCC8930 Chipset. Say Y here if you
	  have such a device.

config CHIP_TCC8935
	bool "TCC8935 Chipset"
	help
	  Support for the TCC8935 Chipset. Say Y here if you
	  have such a device.

config CHIP_TCC8935S
	bool "TCC8935S Chipset"
	help
	  Support for the TCC8935S Chipset. Say Y here if you
	  have such a device.

config CHIP_TCC8933
	bool "TCC8933 Chipset"
	help
	  Support for the TCC8933 Chipset. Say Y here if you
	  have such a device.

config CHIP_TCC8933S
	bool "TCC8933S Chipset"
	help
	  Support for the TCC8933S Chipset. Say Y here if you
	  have such a device.

config CHIP_TCC8937S
	bool "TCC8937S Chipset"
	help
	  Support for the TCC8937S Chipset. Say Y here if you
	  have such a device.

endchoice

choice
	prompt "TCC893x Board(Machine) Type"
	default MACH_TCC893X
	depends on ARCH_TCC893X
	help
	  Select TCC893x board type.

config MACH_TCC893X
	bool "TCC8930 evaluation board"
	help
	  Support for the TCC8930 evaluation board. Say Y here if you
	  have such a device.

config MACH_TCC8930ST
	bool "TCC8930 STB evaluation board"
	help
	  Support for the TCC8930 STB evaluation board. Say Y here if you
	  have such a device.

config MACH_M805_893X
	bool "M805_TCC893x board"
	help
	  Support for the TCC893x M805 board. Say Y here if you
	  have such a device.
endchoice

choice
	prompt "TCC893x Board Rev."
	default DAUDIO
	depends on MACH_TCC893X
	help
	  Select TCC893x board Rev.

config DAUDIO
	bool "D-Audio Board"
	depends on MACH_TCC893X
	help
	  Support for the TCC893X D-Audio board. Say Y here if you
	  have such a device.
endchoice

choice
	prompt "TCC893X D-Audio Board"
	default DAUDIO_20140220
	depends on DAUDIO
	help
	  Select D-Audio Board Rev.

config DAUDIO_20130610
	bool "D-Audio Board Rev. 2013/06/10"
	depends on DAUDIO
	help
	  Support D-Audio Borad Rev. 2013/06/10

config DAUDIO_20131007
    bool "D-Audio Board Rev. 2013/10/07"
    depends on DAUDIO
    help
      Support D-Audio Borad Rev. 2013/10/07

config DAUDIO_20140220
    bool "D-Audio Board Rev. 2014/02/20"
	select SND_SOC_DAUDIO_NEW_SOUND_SYSTEM
    depends on DAUDIO
    help
      Support D-Audio Borad Rev. 2014/02/20
endchoice

config DAUDIO_BSP_VERSION
    int "D-Audio BSP version"
    range 20131106 20150730
    depends on DAUDIO
    default 20150211

config DAUDIO_PRINT_DRAM_DELAY
	bool "D-Audio - Show log message dram delay"
	depends on DAUDIO
	default n

config DAUDIO_USE_USB_MODE
	bool "D-Audio - Use debug board control (USB mode)"
	depends on DAUDIO
	default n

choice
	prompt "TCC893x STB Board"
	default STB_BOARD_EV_TCC893X
	depends on MACH_TCC8930ST
	help
	  Select TCC893x STB Board Type.

config STB_BOARD_EV_TCC893X
	bool "TCC8930 STB EV board"
	depends on MACH_TCC8930ST
	help
	  Support for TCC8930 STB Base Board.

config STB_BOARD_YJ8930T
	bool "TCC8930 YJ8930T board"
	depends on MACH_TCC8930ST
	help
	  Support for TCC8930 YJ8930T Board.

config STB_BOARD_YJ8933T
	bool "TCC8933 YJ8933T board"
	depends on MACH_TCC8930ST
	help
	  Support for TCC8933 YJ8933T Board.

config STB_BOARD_YJ8935T
	bool "TCC8935 YJ8935T board"
	depends on MACH_TCC8930ST
	help
	  Support for TCC8935 YJ8935T Board.

config STB_BOARD_DONGLE_TCC893X
	bool "TCC8935 HDMI dongle board"
	depends on MACH_TCC8930ST
	help
	  Support for TCC8935 HDMI Dongle Board.

config STB_BOARD_UPC_TCC893X
        bool "TCC8935 uPC board"
        depends on MACH_TCC8930ST
        help
          Support for TCC8935 UPC Board.
endchoice

choice
	prompt "TCC893x HDMI Dongle WiFi Chip"
	default HDMI_DONGLE_WIFI_REALTEK_TCC893x
	depends on STB_BOARD_DONGLE_TCC893X
	help
	  Select WiFi Chip of TCC8935 HDMI Dongle Board.

config HDMI_DONGLE_WIFI_REALTEK_TCC893x
	bool "Realtek RTL8188/8189"
	depends on STB_BOARD_DONGLE_TCC893X
	help
	  Support Realtek RTL8188/8189 for TCC8935 HDMI Dongle Board.
endchoice

config GPIO_CORE_VOLTAGE_CONTROL
        bool "Ctrl cpu voltage A/B voltage by gpio ports"
        depends on MACH_TCC8930ST
        help
          Support for the TCC8930 STB Board.


config TCC_OUTPUT_STARTER
        bool "TCC OUTPUT show boot logo image on HDMI/CVBS/Component"
        depends on (ARCH_TCC893X || MACH_TCC8930ST)
        default n
        help
          Support for the TCC893x STB board, Say Y here if you want
          to show boot logo by using HDMI/CVBS/Component output

config AUTO_HOTPLUG
	bool "Auto Hotplug"
	depends on (ARCH_TCC893X)
	default n

config IOBUS_DFS
	bool "I/O(HS I/O) Bus DFS"
	depends on (ARCH_TCC893X)
	default n

config AUDIO_PLL_USE
	bool "Audio PLL use"
	depends on (CHIP_TCC8930 || CHIP_TCC8933 || CHIP_TCC8935) && ARCH_TCC893X
	default n

config TCC_CPUFREQ_HIGHSPEED_CLOCK
	int "Rate of Highspeed CPU clock (850 ~ 1200)MHz"
	range 850 1200
	depends on ARCH_TCC893X
	default "1200"

config HIGHSPEED_TIME_LIMIT
	bool "HighSpeed Time Limit"
	depends on ARCH_TCC893X
	default n

config HIGHSPEED_HIGHSPEED_TIME
	int "Time(sec) of Highspeed CPU clock (1-30)"
	range 1 30
	depends on HIGHSPEED_TIME_LIMIT
	default "5"

config HIGHSPEED_LIMITED_TIME
	int "Time(sec) of Limited CPU clock (1-30)"
	range 1 30
	depends on HIGHSPEED_TIME_LIMIT
	default "15"

config HIGHSPEED_LIMITED_CLOCK
	int "Rate of Time Limited CPU clock (524 ~ 1000)MHz"
	range 524 1000
	depends on HIGHSPEED_TIME_LIMIT
	default "1000"

endif
```

## kernel/drivers/char/tcc_cm3_ctrl/Kconfig
```kconfig
config TCC_CM3_USE
	tristate "Use to TCC893x Cortex-M3 Sub-core"
	default y
	depends on ARCH_TCC893X
	help
		CM3 Sub-core driver support for TCC893x.
```

## kernel/drivers/char/tcc_cmmb_ctrl/Kconfig
```kconfig
config TCC_CMMB_SUPPORT
	tristate "Support to TCC893x CMMB Video Interface"
	default n
	depends on ARCH_TCC893X
	help
		Support to TCC893x CMMB Video Interface.
```

## kernel/drivers/input/touchscreen/Kconfig
```kconfig
#
# Touchscreen driver configuration
#
menuconfig INPUT_TOUCHSCREEN
	bool "Touchscreens"
	help
	  Say Y here, and a list of supported touchscreens will be displayed.
	  This option doesn't affect the kernel.

	  If unsure, say Y.

if INPUT_TOUCHSCREEN

config TOUCHSCREEN_ATMEL_MXT_336S_AT
	tristate "Atmel mXT I2C Touchscreen (MXT_336S_AT)"
	depends on I2C
	help
	  Say Y here if you have Atmel mXT MXT_336S_AT I2C touchscreen,
	  connected to your system.

config DISASSEMBLED_MONITOR
	bool "disassembled monitor model"
	help
		DAUDIO YG Model

config TOUCHSCREEN_SOLOMON_SSD2532
	bool "Solomon Touch IC"
	help
		Global Daudio Solomon Touch IC

endif
```

## kernel/drivers/usb/dio/Kconfig
```kconfig
config USB_DIO
	tristate "DIO Support"
        depends on (USB)
	help
	  Say Y or M here if your system has XXX.
```

## kernel/sound/soc/tcc/Kconfig
```kconfig
config SND_SOC_TCC
	tristate "SoC Audio for the Telechips TCC chip"
	depends on (ARCH_TCC92XX || ARCH_TCC93XX || ARCH_TCC88XX || ARCH_TCC892X || ARCH_TCC893X) && SND_SOC
	help
	  Say Y or M if you want to add support for codecs attached to
	  the TCC I2S interface. You will also need
	  to select the audio interfaces to support below.
	  
config SND_SOC_TCC_BOARD_WM8731
	bool "WM8731"
	select SND_SOC_TCC_I2S
	select SND_SOC_WM8731
	depends on SND_SOC_TCC && (MACH_TCC9300 || MACH_TCC9300CM || MACH_TCC8800 || MACH_TCC8900 || MACH_TCC9201 || MACH_TCC8920 || MACH_TCC893X) 
	help
	  Say Y if you want to add support for SoC audio on Telechips
	  TCC (WM8731).

config SND_SOC_TCC_BOARD_WM8750
	bool "WM8750"
	select SND_SOC_TCC_I2S
	select SND_SOC_WM8750
	depends on SND_SOC_TCC && MACH_TCC9200S
	help
	  Say Y if you want to add support for SoC audio on Telechips
	  TCC (WM8750).	  

config SND_SOC_TCC_BOARD_WM8524
        bool "WM8524"
        select SND_SOC_TCC_I2S
        select SND_SOC_WM8524
        depends on SND_SOC_TCC && (MACH_TCC9300ST || MACH_TCC8800ST || MACH_TCC8920ST || MACH_TCC8930ST || MACH_TCC893X)
        help
          Say Y if you want to add support for SoC audio on Telechips
          TCC (WM8524).

config SND_SOC_TCC_BOARD_WM8988
	bool "WM8988"
	select SND_SOC_TCC_I2S
	select SND_SOC_WM8988
	depends on SND_SOC_TCC && (MACH_M57TE || MACH_M801_88 || MACH_M803 || MACH_TCC9200 || MACH_TCC9201 || MACH_TCC8900 || MACH_M805_892X)
	help
	  Say Y if you want to add support for SoC audio on Telechips
	  TCC (WM8988).

config SND_SOC_TCC_BOARD_WM8993
	bool "WM8993"
	select SND_SOC_TCC_I2S
	select SND_SOC_WM8993
	depends on SND_SOC_TCC && MACH_TCC9300
	help
	  Say Y if you want to add support for SoC audio on Telechips
	  TCC (WM8993).	  

config SND_SOC_TCC_BOARD_ES8388
	bool "ES8388"
	select SND_SOC_TCC_I2S
	select SND_SOC_ES8388
	depends on SND_SOC_TCC && (MACH_M801_88 || MACH_M805_892X)
	help
	  Say Y if you want to add support for SoC audio on Telechips
	  TCC (ES8388).

config SND_SOC_TCC_BOARD_WM8994
	bool "WM8994"
	select SND_SOC_TCC_I2S
	select SND_SOC_WM8994
	depends on SND_SOC_TCC && MACH_TCC9300
	help
	  Say Y if you want to add support for SoC audio on Telechips
	  TCC (WM8994).	  

config SND_SOC_TCC_MULTICHANNEL
	bool "TCC MultiChannel"
	select SND_SOC_TCC_I2S
	depends on SND_SOC_TCC
	help
	  Say Y if you want to add support for SoC audio on Telechips
	  TCC.	  
	
config SND_SOC_DAUDIO_NEW_SOUND_SYSTEM
	bool "DAudio New Sound System - MultiChannel"
  	select SND_SOC_TCC_I2S
  	select SND_SOC_TCC_MULTICHANNEL
	depends on SND_SOC_TCC && MACH_TCC893X && DAUDIO
	help
	  Say Y if you want to apply daudio new sound system.

config SND_SOC_DAUDIO_CLOCK_CONTROL
	  bool "DAudio Clock Control"
	  select SND_SOC_TCC_I2S
	  depends on SND_SOC_TCC && MACH_TCC893X && DAUDIO
	  help
	  Say Y if you want to apply daudio clock control.

config SND_SOC_TCC_BOARD_RT5625
	bool "RT5625"
	select SND_SOC_TCC_I2S
	select SND_SOC_RT5625
	depends on SND_SOC_TCC && (MACH_M801_88 || MACH_M805_892X || MACH_M805_893X)
	help
	  Say Y if you want to add support for SoC audio on Telechips
	  TCC (RT5625).

config SND_SOC_TCC_BOARD_RT5633
	bool "RT5633"
	select SND_SOC_TCC_I2S
	select SND_SOC_RT5633
	depends on SND_SOC_TCC && (MACH_M801_88 || MACH_M805_892X || MACH_M805_893X)
	help
	  Say Y if you want to add support for SoC audio on Telechips
	  TCC (RT5633).
	  
config SND_SOC_TCC_BOARD_RT5631
	bool "RT5631"
	select SND_SOC_TCC_I2S
	select SND_SOC_RT5631
	depends on SND_SOC_TCC && (MACH_M801_88 || MACH_M805_892X || MACH_M805_893X)
	help
	  Say Y if you want to add support for SoC audio on Telechips
	  TCC (RT5631).		  

config SND_SOC_DAUDIO_BOARD
	bool "Snd D-audio Board"
	select SND_SOC_TCC_I2S
	select SND_SOC_FM1288
	select SND_SOC_NXP
	depends on DAUDIO
	help
	  Say Y if you want to add support for FM1288 & NXP on D-Audio Board

config SND_SOC_TCC_I2S
	tristate

config SND_SOC_DAUDIO_CLOCK_ROLE_SWITCHING
	bool "Audio clock role switching"
	select SND_SOC_TCC_I2S
	depends on DAUDIO
	help
	  Say Y if you want to add support audio clock role switching

config SND_SOC_DAUDIO_SUPPORT_PCMIF
	bool "PCM interface"
	select SND_SOC_TCC_I2S
	depends on DAUDIO
	help
	  Say Y if you want to add support pcm interface

config SND_SOC_TCC_CDIF
	bool "TCC CDIF"
	depends on DAUDIO
	help
	  Say Y if you want to add support for TCC CDIF
```
